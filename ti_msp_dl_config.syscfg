//@cliArgs --device "MSPM0G350X" --package "LQFP-64(PM)" --part "Default"

const ADC12 = scripting.addModule("/ti/driverlib/ADC12", {}, false);
const ADC121 = ADC12.addInstance();
const Board = scripting.addModule("/ti/driverlib/Board");
const GPIO = scripting.addModule("/ti/driverlib/GPIO", {}, false);
const GPIO1 = GPIO.addInstance();
const GPIO2 = GPIO.addInstance();
const GPIO3 = GPIO.addInstance();
const PWM = scripting.addModule("/ti/driverlib/PWM", {}, false);
const PWM1 = PWM.addInstance();
const SPI = scripting.addModule("/ti/driverlib/SPI", {}, false);
const SPI1 = SPI.addInstance();
const TIMER = scripting.addModule("/ti/driverlib/TIMER", {}, false);
const TIMER1 = TIMER.addInstance();

ADC121.$name = "ADC_MIC_JOY";
ADC121.sampClkDiv = "DL_ADC12_CLOCK_DIVIDE_8";
ADC121.sampleTime0 = "125 us";
ADC121.samplingOperationMode = "sequence";
ADC121.repeatMode = true;
ADC121.endAdd = 2;
ADC121.enabledInterrupts = ["DL_ADC12_INTERRUPT_MEM0_RESULT_LOADED","DL_ADC12_INTERRUPT_MEM1_RESULT_LOADED","DL_ADC12_INTERRUPT_MEM2_RESULT_LOADED"];
ADC121.adcMem0chansel = "DL_ADC12_INPUT_CHAN_2";
ADC121.adcMem1chansel = "DL_ADC12_INPUT_CHAN_1";
ADC121.adcMem2chansel = "DL_ADC12_INPUT_CHAN_0";
ADC121.peripheral.$assign = "ADC0";

Board.peripheral.$assign = "DEBUGSS";

GPIO1.$name = "GPIO_BUTTONS";
GPIO1.associatedPins.create(3);
GPIO1.associatedPins[0].$name = "S1";
GPIO1.associatedPins[0].direction = "INPUT";
GPIO1.associatedPins[0].internalResistor = "PULL_UP";
GPIO1.associatedPins[0].interruptEn = true;
GPIO1.associatedPins[0].polarity = "FALL";
GPIO1.associatedPins[1].$name = "S2";
GPIO1.associatedPins[1].direction = "INPUT";
GPIO1.associatedPins[1].internalResistor = "PULL_UP";
GPIO1.associatedPins[1].interruptEn = true;
GPIO1.associatedPins[1].polarity = "FALL";
GPIO1.associatedPins[2].$name = "JOY_SEL";
GPIO1.associatedPins[2].direction = "INPUT";
GPIO1.associatedPins[2].internalResistor = "PULL_UP";
GPIO1.associatedPins[2].interruptEn = true;
GPIO1.associatedPins[2].polarity = "FALL";

GPIO2.$name = "GPIO_RGB";
GPIO2.associatedPins.create(3);
GPIO2.associatedPins[0].$name = "RED";
GPIO2.associatedPins[0].initialValue = "SET";
GPIO2.associatedPins[1].$name = "GREEN";
GPIO2.associatedPins[1].initialValue = "SET";
GPIO2.associatedPins[2].$name = "BLUE";
GPIO2.associatedPins[2].initialValue = "SET";

GPIO3.$name = "GPIO_LCD";
GPIO3.associatedPins.create(2);
GPIO3.associatedPins[0].$name = "RST";
GPIO3.associatedPins[1].$name = "DC";

PWM1.$name = "PWM_AUDIO";
PWM1.timerStartTimer = true;
PWM1.timerCount = 3199;
PWM1.peripheral.$assign = "TIMG0";

SPI1.$name = "SPI_LCD";
SPI1.targetBitRate = 10000000;
SPI1.peripheral.$assign = "SPI1";

TIMER1.$name = "TIMER_SAMPLE";
TIMER1.timerMode = "PERIODIC";
TIMER1.timerPeriod = "125 us";
TIMER1.interrupts = ["ZERO"];
TIMER1.interruptPriority = "1";
TIMER1.timerStartTimer = true;
TIMER1.peripheral.$assign = "TIMG7";
