/**
 * These arguments were used when this file was generated. They will be automatically applied on subsequent loads
 * via the GUI or CLI. Run CLI with '--help' for additional information on how to override these arguments.
 * @cliArgs --device "MSPM0G350X" --part "Default" --package "LQFP-64(PM)" --product "mspm0_sdk@2.08.00.03"
 * @v2CliArgs --device "MSPM0G3505" --package "LQFP-64(PM)" --product "mspm0_sdk@2.08.00.03"
 * @versions {"tool":"1.25.0+4268"}
 */

/**
 * Import the modules used in this configuration.
 */
const ADC12         = scripting.addModule("/ti/driverlib/ADC12", {}, false);
const ADC121        = ADC12.addInstance();
const ADC122        = ADC12.addInstance();
const Board         = scripting.addModule("/ti/driverlib/Board");
const GPIO          = scripting.addModule("/ti/driverlib/GPIO", {}, false);
const GPIO1         = GPIO.addInstance();
const GPIO2         = GPIO.addInstance();
const GPIO3         = GPIO.addInstance();
const PWM           = scripting.addModule("/ti/driverlib/PWM", {}, false);
const PWM1          = PWM.addInstance();
const SPI           = scripting.addModule("/ti/driverlib/SPI", {}, false);
const SPI1          = SPI.addInstance();
const TIMER         = scripting.addModule("/ti/driverlib/TIMER", {}, false);
const TIMER1        = TIMER.addInstance();
const VREF          = scripting.addModule("/ti/driverlib/VREF");
const ProjectConfig = scripting.addModule("/ti/project_config/ProjectConfig");

/**
 * Write custom configuration values to the imported modules.
 */
ADC121.$name                             = "ADC_MIC_JOY";
ADC121.sampClkDiv                        = "DL_ADC12_CLOCK_DIVIDE_8";
ADC121.sampleTime0                       = "125 us";
ADC121.samplingOperationMode             = "sequence";
ADC121.repeatMode                        = true;
ADC121.endAdd                            = 2;
ADC121.enabledInterrupts                 = ["DL_ADC12_INTERRUPT_MEM0_RESULT_LOADED","DL_ADC12_INTERRUPT_MEM1_RESULT_LOADED","DL_ADC12_INTERRUPT_MEM2_RESULT_LOADED"];
ADC121.adcMem0chansel                    = "DL_ADC12_INPUT_CHAN_2";
ADC121.adcMem1chansel                    = "DL_ADC12_INPUT_CHAN_1";
ADC121.adcPin0Config.$name               = "ti_driverlib_gpio_GPIOPinGeneric0";
ADC121.adcPin0Config.hideOutputInversion = scripting.forceWrite(false);
ADC121.adcPin2Config.$name               = "ti_driverlib_gpio_GPIOPinGeneric9";
ADC121.peripheral.$assign                = "ADC0";
ADC121.adcPin1Config.$name               = "ti_driverlib_gpio_GPIOPinGeneric10";

ADC122.$name                 = "ADC_ACCEL";
ADC122.sampClkDiv            = "DL_ADC12_CLOCK_DIVIDE_8";
ADC122.sampleTime0           = "125 us";
ADC122.samplingOperationMode = "sequence";
ADC122.repeatMode            = true;
ADC122.endAdd                = 2;
ADC122.enabledInterrupts     = ["DL_ADC12_INTERRUPT_MEM0_RESULT_LOADED","DL_ADC12_INTERRUPT_MEM1_RESULT_LOADED","DL_ADC12_INTERRUPT_MEM2_RESULT_LOADED"];
ADC122.adcMem0chansel        = "DL_ADC12_INPUT_CHAN_2";
ADC122.adcMem0vref           = "VREF";
ADC122.adcMem1chansel        = "DL_ADC12_INPUT_CHAN_3";
ADC122.adcMem1vref           = "VREF";
ADC122.adcMem2chansel        = "DL_ADC12_INPUT_CHAN_7";
ADC122.adcMem2vref           = "VREF";
ADC122.adcPin2Config.$name   = "ti_driverlib_gpio_GPIOPinGeneric11";
ADC122.adcPin3Config.$name   = "ti_driverlib_gpio_GPIOPinGeneric12";
ADC122.peripheral.$assign    = "ADC1";
ADC122.adcPin7Config.$name   = "ti_driverlib_gpio_GPIOPinGeneric1";

Board.genPeriphPinFile   = true;
Board.genResourceCSV     = true;
Board.configureVDDA      = true;
Board.configureUnused    = true;
Board.peripheral.$assign = "DEBUGSS";
Board.genFileMod.$name   = "ti_driverlib_BoardPins0";
Board.genFileCSV.$name   = "ti_driverlib_ResourcesCSV0";

GPIO1.$name                              = "GPIO_BUTTONS";
GPIO1.associatedPins.create(3);
GPIO1.associatedPins[0].$name            = "S1";
GPIO1.associatedPins[0].direction        = "INPUT";
GPIO1.associatedPins[0].internalResistor = "PULL_UP";
GPIO1.associatedPins[0].interruptEn      = true;
GPIO1.associatedPins[0].polarity         = "FALL";
GPIO1.associatedPins[1].$name            = "S2";
GPIO1.associatedPins[1].direction        = "INPUT";
GPIO1.associatedPins[1].internalResistor = "PULL_UP";
GPIO1.associatedPins[1].interruptEn      = true;
GPIO1.associatedPins[1].polarity         = "FALL";
GPIO1.associatedPins[2].$name            = "JOY_SEL";
GPIO1.associatedPins[2].direction        = "INPUT";
GPIO1.associatedPins[2].internalResistor = "PULL_UP";
GPIO1.associatedPins[2].interruptEn      = true;
GPIO1.associatedPins[2].polarity         = "FALL";

GPIO2.$name                          = "GPIO_RGB";
GPIO2.associatedPins.create(3);
GPIO2.associatedPins[0].$name        = "RED";
GPIO2.associatedPins[0].initialValue = "SET";
GPIO2.associatedPins[1].$name        = "GREEN";
GPIO2.associatedPins[1].initialValue = "SET";
GPIO2.associatedPins[2].$name        = "BLUE";
GPIO2.associatedPins[2].initialValue = "SET";

GPIO3.$name                   = "GPIO_LCD";
GPIO3.associatedPins.create(2);
GPIO3.associatedPins[0].$name = "RST";
GPIO3.associatedPins[1].$name = "DC";

PWM1.$name                              = "PWM_AUDIO";
PWM1.timerStartTimer                    = true;
PWM1.timerCount                         = 3199;
PWM1.peripheral.$assign                 = "TIMG0";
PWM1.PWM_CHANNEL_0.$name                = "ti_driverlib_pwm_PWMTimerCC0";
PWM1.PWM_CHANNEL_1.$name                = "ti_driverlib_pwm_PWMTimerCC1";
PWM1.ccp0PinConfig.$name                = "ti_driverlib_gpio_GPIOPinGeneric2";
PWM1.ccp0PinConfig.direction            = scripting.forceWrite("OUTPUT");
PWM1.ccp0PinConfig.hideOutputInversion  = scripting.forceWrite(false);
PWM1.ccp0PinConfig.onlyInternalResistor = scripting.forceWrite(false);
PWM1.ccp0PinConfig.passedPeripheralType = scripting.forceWrite("Digital");
PWM1.ccp1PinConfig.$name                = "ti_driverlib_gpio_GPIOPinGeneric3";
PWM1.ccp1PinConfig.direction            = scripting.forceWrite("OUTPUT");
PWM1.ccp1PinConfig.hideOutputInversion  = scripting.forceWrite(false);
PWM1.ccp1PinConfig.onlyInternalResistor = scripting.forceWrite(false);
PWM1.ccp1PinConfig.passedPeripheralType = scripting.forceWrite("Digital");

SPI1.$name                              = "SPI_LCD";
SPI1.targetBitRate                      = 10000000;
SPI1.peripheral.$assign                 = "SPI1";
SPI1.sclkPinConfig.$name                = "ti_driverlib_gpio_GPIOPinGeneric4";
SPI1.sclkPinConfig.direction            = scripting.forceWrite("OUTPUT");
SPI1.sclkPinConfig.onlyInternalResistor = scripting.forceWrite(false);
SPI1.sclkPinConfig.passedPeripheralType = scripting.forceWrite("Digital");
SPI1.mosiPinConfig.$name                = "ti_driverlib_gpio_GPIOPinGeneric5";
SPI1.mosiPinConfig.direction            = scripting.forceWrite("OUTPUT");
SPI1.mosiPinConfig.hideOutputInversion  = scripting.forceWrite(false);
SPI1.mosiPinConfig.onlyInternalResistor = scripting.forceWrite(false);
SPI1.mosiPinConfig.passedPeripheralType = scripting.forceWrite("Digital");
SPI1.misoPinConfig.$name                = "ti_driverlib_gpio_GPIOPinGeneric6";
SPI1.misoPinConfig.onlyInternalResistor = scripting.forceWrite(false);
SPI1.misoPinConfig.passedPeripheralType = scripting.forceWrite("Digital");
SPI1.cs0PinConfig.$name                 = "ti_driverlib_gpio_GPIOPinGeneric7";
SPI1.cs0PinConfig.direction             = scripting.forceWrite("OUTPUT");
SPI1.cs0PinConfig.hideOutputInversion   = scripting.forceWrite(false);
SPI1.cs0PinConfig.onlyInternalResistor  = scripting.forceWrite(false);
SPI1.cs0PinConfig.passedPeripheralType  = scripting.forceWrite("Digital");

const SYSCTL = scripting.addModule("/ti/driverlib/SYSCTL", {}, false);

TIMER1.$name              = "TIMER_SAMPLE";
TIMER1.timerMode          = "PERIODIC";
TIMER1.timerPeriod        = "125 us";
TIMER1.interrupts         = ["ZERO"];
TIMER1.interruptPriority  = "1";
TIMER1.timerStartTimer    = true;
TIMER1.peripheral.$assign = "TIMG7";

VREF.basicIntVolt           = "DL_VREF_BUFCONFIG_OUTPUT_2_5V";
VREF.checkVREFReady         = true;
VREF.peripheral.$assign     = "VREF";
VREF.vrefPosPinConfig.$name = "ti_driverlib_gpio_GPIOPinGeneric8";

ProjectConfig.genLibDrivers = true;
ProjectConfig.genLibCMSIS   = true;

/**
 * Pinmux solution for unlocked pins/peripherals. This ensures that minor changes to the automatic solver in a future
 * version of the tool will not impact the pinmux you originally saw.  These lines can be completely deleted in order to
 * re-solve from scratch.
 */
ADC121.peripheral.adcPin2.$suggestSolution   = "PA25";
ADC121.peripheral.adcPin1.$suggestSolution   = "PA26";
ADC121.peripheral.adcPin0.$suggestSolution   = "PA27";
ADC122.peripheral.adcPin2.$suggestSolution   = "PA17";
ADC122.peripheral.adcPin3.$suggestSolution   = "PA18";
ADC122.peripheral.adcPin7.$suggestSolution   = "PA21";
Board.peripheral.swclkPin.$suggestSolution   = "PA20";
Board.peripheral.swdioPin.$suggestSolution   = "PA19";
GPIO1.associatedPins[0].pin.$suggestSolution = "PA14";
GPIO1.associatedPins[1].pin.$suggestSolution = "PB14";
GPIO1.associatedPins[2].pin.$suggestSolution = "PB13";
GPIO2.associatedPins[0].pin.$suggestSolution = "PA15";
GPIO2.associatedPins[1].pin.$suggestSolution = "PB17";
GPIO2.associatedPins[2].pin.$suggestSolution = "PB18";
GPIO3.associatedPins[0].pin.$suggestSolution = "PB19";
GPIO3.associatedPins[1].pin.$suggestSolution = "PA22";
PWM1.peripheral.ccp0Pin.$suggestSolution     = "PA12";
PWM1.peripheral.ccp1Pin.$suggestSolution     = "PA13";
SPI1.peripheral.sclkPin.$suggestSolution     = "PB16";
SPI1.peripheral.mosiPin.$suggestSolution     = "PB15";
SPI1.peripheral.misoPin.$suggestSolution     = "PA16";
SPI1.peripheral.cs0Pin.$suggestSolution      = "PA2";
SYSCTL.peripheral.$suggestSolution           = "SYSCTL";
VREF.peripheral.vrefPosPin.$suggestSolution  = "PA23";
