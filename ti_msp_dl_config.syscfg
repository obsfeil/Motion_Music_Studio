/**
 * These arguments were used when this file was generated. They will be automatically applied on subsequent loads
 * via the GUI or CLI. Run CLI with '--help' for additional information on how to override these arguments.
 * @cliArgs --board "/ti/boards/LP_MSPM0G3507" --product "mspm0_sdk@2.09.00.02"
 * @v2CliArgs --board "/ti/boards/LP_MSPM0G3507" --product "mspm0_sdk@2.09.00.02"
 * @versions {"tool":"1.25.0+4268"}
 */

/**
 * Import the modules used in this configuration.
 */
const ADC12         = scripting.addModule("/ti/driverlib/ADC12", {}, false);
const ADC121        = ADC12.addInstance();
const ADC122        = ADC12.addInstance();
const Board         = scripting.addModule("/ti/driverlib/Board");
const GPIO          = scripting.addModule("/ti/driverlib/GPIO", {}, false);
const GPIO1         = GPIO.addInstance();
const GPIO2         = GPIO.addInstance();
const GPIO3         = GPIO.addInstance();
const I2C           = scripting.addModule("/ti/driverlib/I2C", {}, false);
const I2C1          = I2C.addInstance();
const I2C2          = I2C.addInstance();
const PWM           = scripting.addModule("/ti/driverlib/PWM", {}, false);
const PWM1          = PWM.addInstance();
const RTC           = scripting.addModule("/ti/driverlib/RTC");
const SPI           = scripting.addModule("/ti/driverlib/SPI", {}, false);
const SPI1          = SPI.addInstance();
const SYSCTL        = scripting.addModule("/ti/driverlib/SYSCTL");
const TIMER         = scripting.addModule("/ti/driverlib/TIMER", {}, false);
const TIMER1        = TIMER.addInstance();
const VREF          = scripting.addModule("/ti/driverlib/VREF");
const ProjectConfig = scripting.addModule("/ti/project_config/ProjectConfig");

/**
 * Write custom configuration values to the imported modules.
 */
ADC121.$name                      = "ADC_MIC_JOY";
ADC121.sampleTime0                = "125 us";
ADC121.samplingOperationMode      = "sequence";
ADC121.repeatMode                 = true;
ADC121.endAdd                     = 2;
ADC121.adcMem0vref                = "VREF";
ADC121.adcMem1vref                = "VREF";
ADC121.adcMem2vref                = "VREF";
ADC121.trigSrc                    = "DL_ADC12_TRIG_SRC_EVENT";
ADC121.subChanID                  = 1;
ADC121.enabledInterrupts          = ["DL_ADC12_INTERRUPT_MEM0_RESULT_LOADED","DL_ADC12_INTERRUPT_MEM1_RESULT_LOADED","DL_ADC12_INTERRUPT_MEM2_RESULT_LOADED"];
ADC121.enabledEvents              = ["DL_ADC12_EVENT_MEM0_RESULT_LOADED"];
ADC121.adcMem2chansel             = "DL_ADC12_INPUT_CHAN_7";
ADC121.adcMem1chansel             = "DL_ADC12_INPUT_CHAN_2";
ADC121.adcPin7Config.$name        = "ti_driverlib_gpio_GPIOPinGeneric0";
ADC121.adcPin2Config.$name        = "ti_driverlib_gpio_GPIOPinGeneric9";
ADC121.peripheral.adcPin2.$assign = "boosterpack.2";
ADC121.peripheral.adcPin7.$assign = "boosterpack.24";
ADC121.adcPin0Config.$name        = "ti_driverlib_gpio_GPIOPinGeneric3";

ADC122.$name                             = "ADC_ACCEL";
ADC122.sampClkDiv                        = "DL_ADC12_CLOCK_DIVIDE_8";
ADC122.sampleTime0                       = "125 us";
ADC122.samplingOperationMode             = "sequence";
ADC122.repeatMode                        = true;
ADC122.endAdd                            = 2;
ADC122.adcMem2chansel                    = "DL_ADC12_INPUT_CHAN_7";
ADC122.adcMem0vref                       = "VREF";
ADC122.adcMem1vref                       = "VREF";
ADC122.adcMem2vref                       = "VREF";
ADC122.enabledInterrupts                 = ["DL_ADC12_INTERRUPT_MEM0_RESULT_LOADED","DL_ADC12_INTERRUPT_MEM1_RESULT_LOADED","DL_ADC12_INTERRUPT_MEM2_RESULT_LOADED"];
ADC122.adcMem0chansel                    = "DL_ADC12_INPUT_CHAN_3";
ADC122.adcPin0Config.hideOutputInversion = scripting.forceWrite(false);
ADC122.adcPin0Config.$name               = "ti_driverlib_gpio_GPIOPinGeneric10";
ADC122.adcPin7Config.$name               = "ti_driverlib_gpio_GPIOPinGeneric1";
ADC122.adcPin3Config.$name               = "ti_driverlib_gpio_GPIOPinGeneric7";

Board.genPeriphPinFile            = true;
Board.genResourceCSV              = true;
Board.configureVDDA               = true;
Board.globalFastWakeEn            = true;
Board.configureUnused             = true;
Board.peripheral.$assign          = "DEBUGSS";
Board.peripheral.swclkPin.$assign = "j25_expansion.16";
Board.peripheral.swdioPin.$assign = "j25_expansion.14";
Board.genFileMod.$name            = "ti_driverlib_BoardPins0";
Board.genFileCSV.$name            = "ti_driverlib_ResourcesCSV0";

GPIO1.$name                              = "GPIO_BUTTONS";
GPIO1.associatedPins.create(3);
GPIO1.associatedPins[0].$name            = "S1";
GPIO1.associatedPins[0].direction        = "INPUT";
GPIO1.associatedPins[0].internalResistor = "PULL_UP";
GPIO1.associatedPins[0].interruptEn      = true;
GPIO1.associatedPins[0].polarity         = "FALL";
GPIO1.associatedPins[0].pin.$assign      = "boosterpack.33";
GPIO1.associatedPins[1].$name            = "S2";
GPIO1.associatedPins[1].direction        = "INPUT";
GPIO1.associatedPins[1].internalResistor = "PULL_UP";
GPIO1.associatedPins[1].interruptEn      = true;
GPIO1.associatedPins[1].polarity         = "RISE";
GPIO1.associatedPins[1].pin.$assign      = "boosterpack.32";
GPIO1.associatedPins[2].$name            = "JOY_SEL";
GPIO1.associatedPins[2].direction        = "INPUT";
GPIO1.associatedPins[2].internalResistor = "PULL_UP";
GPIO1.associatedPins[2].interruptEn      = true;
GPIO1.associatedPins[2].polarity         = "FALL";
GPIO1.associatedPins[2].pin.$assign      = "boosterpack.5";

GPIO2.$name                          = "GPIO_RGB";
GPIO2.associatedPins.create(3);
GPIO2.associatedPins[0].$name        = "RED";
GPIO2.associatedPins[0].initialValue = "SET";
GPIO2.associatedPins[0].pin.$assign  = "j19_expansion.8";
GPIO2.associatedPins[1].$name        = "GREEN";
GPIO2.associatedPins[1].initialValue = "SET";
GPIO2.associatedPins[1].pin.$assign  = "j19_expansion.10";
GPIO2.associatedPins[2].$name        = "BLUE";
GPIO2.associatedPins[2].initialValue = "SET";
GPIO2.associatedPins[2].pin.$assign  = "j19_expansion.5";

GPIO3.$name                          = "GPIO_LCD";
GPIO3.associatedPins.create(2);
GPIO3.associatedPins[0].$name        = "RST";
GPIO3.associatedPins[0].initialValue = "SET";
GPIO3.associatedPins[0].pin.$assign  = "boosterpack.17";
GPIO3.associatedPins[1].$name        = "DC";
GPIO3.associatedPins[1].initialValue = "SET";
GPIO3.associatedPins[1].ioStructure  = "SD";
GPIO3.associatedPins[1].pin.$assign  = "boosterpack.35";

I2C1.$name                     = "I2C_0";
I2C1.basicEnableController     = true;
I2C1.peripheral.$assign        = "I2C0";
I2C1.peripheral.sdaPin.$assign = "j19_expansion.9";
I2C1.peripheral.sclPin.$assign = "j17_expansion.9";
I2C1.sdaPinConfig.$name        = "ti_driverlib_gpio_GPIOPinGeneric13";
I2C1.sdaPinConfig.enableConfig = true;
I2C1.sclPinConfig.$name        = "ti_driverlib_gpio_GPIOPinGeneric14";
I2C1.sclPinConfig.enableConfig = true;

I2C2.$name                     = "I2C_1";
I2C2.basicEnableController     = true;
I2C2.peripheral.$assign        = "I2C1";
I2C2.peripheral.sdaPin.$assign = "boosterpack.34";
I2C2.sdaPinConfig.$name        = "ti_driverlib_gpio_GPIOPinGeneric15";
I2C2.sclPinConfig.$name        = "ti_driverlib_gpio_GPIOPinGeneric16";

PWM1.$name                              = "PWM_AUDIO";
PWM1.timerStartTimer                    = true;
PWM1.timerCount                         = 4095;
PWM1.interrupts                         = ["ZERO_EVENT"];
PWM1.ccIndex                            = [0];
PWM1.pwmMode                            = "EDGE_ALIGN_UP";
PWM1.PWM_CHANNEL_0.$name                = "ti_driverlib_pwm_PWMTimerCC0";
PWM1.PWM_CHANNEL_0.dutyCycle            = 50;
PWM1.PWM_CHANNEL_0.invert               = true;
PWM1.ccp0PinConfig.direction            = scripting.forceWrite("OUTPUT");
PWM1.ccp0PinConfig.hideOutputInversion  = scripting.forceWrite(false);
PWM1.ccp0PinConfig.onlyInternalResistor = scripting.forceWrite(false);
PWM1.ccp0PinConfig.passedPeripheralType = scripting.forceWrite("Digital");
PWM1.ccp0PinConfig.$name                = "ti_driverlib_gpio_GPIOPinGeneric2";
PWM1.peripheral.ccp0Pin.$assign         = "boosterpack.40";

RTC.peripheral.$assign = "RTC";

SPI1.$name                              = "SPI_LCD";
SPI1.enableDMAEvent1                    = false;
SPI1.enableDMAEvent2                    = false;
SPI1.targetBitRate                      = 16000000;
SPI1.enableInternalLoopback             = true;
SPI1.frameFormat                        = "MOTO3";
SPI1.sclkPinConfig.direction            = scripting.forceWrite("OUTPUT");
SPI1.sclkPinConfig.onlyInternalResistor = scripting.forceWrite(false);
SPI1.sclkPinConfig.passedPeripheralType = scripting.forceWrite("Digital");
SPI1.sclkPinConfig.$name                = "ti_driverlib_gpio_GPIOPinGeneric4";
SPI1.sclkPinConfig.enableConfig         = true;
SPI1.mosiPinConfig.direction            = scripting.forceWrite("OUTPUT");
SPI1.mosiPinConfig.hideOutputInversion  = scripting.forceWrite(false);
SPI1.mosiPinConfig.onlyInternalResistor = scripting.forceWrite(false);
SPI1.mosiPinConfig.passedPeripheralType = scripting.forceWrite("Digital");
SPI1.mosiPinConfig.$name                = "ti_driverlib_gpio_GPIOPinGeneric5";
SPI1.mosiPinConfig.enableConfig         = true;
SPI1.misoPinConfig.onlyInternalResistor = scripting.forceWrite(false);
SPI1.misoPinConfig.passedPeripheralType = scripting.forceWrite("Digital");
SPI1.misoPinConfig.$name                = "ti_driverlib_gpio_GPIOPinGeneric6";
SPI1.misoPinConfig.enableConfig         = true;
SPI1.peripheral.$assign                 = "SPI1";
SPI1.peripheral.sclkPin.$assign         = "boosterpack.7";
SPI1.peripheral.mosiPin.$assign         = "boosterpack.15";
SPI1.peripheral.misoPin.$assign         = "boosterpack.14";

SYSCTL.MFPCLKEn               = true;
SYSCTL.MFCLKEn                = true;
SYSCTL.powerPolicy            = "STANDBY0";
SYSCTL.UDIV                   = "2";
SYSCTL.SYSPLL_CLK2XDiv        = 9;
SYSCTL.powerSysInterrupts     = ["FLASH_SEC"];
SYSCTL.forceDefaultClkConfig  = true;
SYSCTL.validateClkStatus      = true;
SYSCTL.SYSPLL_CLK0En          = true;
SYSCTL.SYSPLL_CLK1En          = true;
SYSCTL.MCLKSource             = "HSCLK";
SYSCTL.EXCLKDivider           = "4";
SYSCTL.SYSPLL_CLK2XEn         = true;
SYSCTL.CANCLKSource           = "SYSPLLCLK1";
SYSCTL.EXCLKSource            = "ULPCLK";
SYSCTL.enableIntDone          = true;
SYSCTL.flashInterruptPriority = "0";
SYSCTL.clockInterrupts        = ["HSCLK_GOOD","SYSPLL_GOOD"];
SYSCTL.vboostMode             = "ONALWAYS";
SYSCTL.peripheral.$assign     = "SYSCTL";

TIMER1.$name                       = "TIMER_SAMPLE";
TIMER1.timerPeriod                 = "125 us";
TIMER1.timerMode                   = "PERIODIC_UP";
TIMER1.interrupts                  = ["ZERO"];
TIMER1.interruptPriority           = "1";
TIMER1.timerStartTimer             = true;
TIMER1.retentionRestoreCnt         = true;
TIMER1.event1PublisherChannel      = 1;
TIMER1.event1ControllerInterruptEn = ["ZERO_EVENT"];
TIMER1.peripheral.$assign          = "TIMG7";

VREF.basicIntVolt                  = "DL_VREF_BUFCONFIG_OUTPUT_2_5V";
VREF.checkVREFReady                = true;
VREF.advClkSrc                     = "DL_VREF_CLOCK_BUSCLK";
VREF.advClkDiv                     = "DL_VREF_CLOCK_DIVIDE_2";
VREF.peripheral.$assign            = "VREF";
VREF.peripheral.vrefPosPin.$assign = "j17_expansion.10";
VREF.vrefPosPinConfig.$name        = "ti_driverlib_gpio_GPIOPinGeneric8";

ProjectConfig.genLibDrivers        = true;
ProjectConfig.genLibCMSIS          = true;
ProjectConfig.migrationCondition   = true;
ProjectConfig.genLibIQ             = true;
ProjectConfig.genLibIQVersion      = "MATHACL";
ProjectConfig.genLibGC             = true;
ProjectConfig.genLibGaugeL2Version = "MATHACL";

/**
 * Pinmux solution for unlocked pins/peripherals. This ensures that minor changes to the automatic solver in a future
 * version of the tool will not impact the pinmux you originally saw.  These lines can be completely deleted in order to
 * re-solve from scratch.
 */
ADC121.peripheral.$suggestSolution         = "ADC0";
ADC121.peripheral.adcPin0.$suggestSolution = "boosterpack.8";
ADC122.peripheral.$suggestSolution         = "ADC1";
ADC122.peripheral.adcPin3.$suggestSolution = "boosterpack.26";
ADC122.peripheral.adcPin0.$suggestSolution = "boosterpack.30";
ADC122.peripheral.adcPin7.$suggestSolution = "j17_expansion.8";
I2C2.peripheral.sclPin.$suggestSolution    = "boosterpack.28";
PWM1.peripheral.$suggestSolution           = "TIMA1";
